## CMakeLists.txt
```
# SPDX-License-Identifier: Apache-2.0

cmake_minimum_required(VERSION 3.13.1)
find_package(Zephyr HINTS $ENV{ZEPHYR_BASE})
project(peng)

FILE(GLOB app_sources src/*.c)
FILE(GLOB extra_sources
  ../common/src/*.c
  ../common/src/abstraction/zephyr/*.c
  ./peng/runtime/src/*.c
  )


target_sources(app PRIVATE ${app_sources} ${extra_sources})
target_include_directories(app PRIVATE
  ../common/src
  ../common/src/abstraction/zephyr
  ./peng/runtime/include
  ./peng-platform/nrf52/include
  ${ZEPHYR_BASE}/kernel/include
  ${ZEPHYR_BASE}/arch/${ARCH}/include)


zephyr_library_include_directories(${ZEPHYR_BASE}/samples/bluetooth)
```

## prj.conf
```kconfig
# CONFIG_BT=y
# CONFIG_BT_GATT_DYNAMIC_DB=y
# # CONFIG_BT_DEBUG_LOG=n
# CONFIG_BT_SMP=y
# CONFIG_BT_PERIPHERAL=y
# CONFIG_BT_DIS=y
# CONFIG_BT_DIS_PNP=y
# CONFIG_BT_DEVICE_NAME="Client"
# CONFIG_BT_CENTRAL=y
# CONFIG_BT_SMP=y

# CONFIG_BT_GATT_CLIENT=y
# CONFIG_BT_GATT_SERVICE_CHANGED=y
# CONFIG_BT_GATT_CACHING=y

# without this it does not link in the k_malloc code, it will just
# cryptically throw undefined reference k_malloc in your face. Including
# kernel.h where it is defined does nothing. With this thing, however, it
# is not even required to include kernel.h.
CONFIG_HEAP_MEM_POOL_SIZE=32768
# This flag is explained here: https://docs.zephyrproject.org/1.9.0/reference/kconfig/CONFIG_SYS_CLOCK_TICKS_PER_SEC.html#cmdoption-arg-config-sys-clock-ticks-per-sec
# CONFIG_SYS_CLOCK_TICKS_PER_SEC=1000
CONFIG_MINIMAL_LIBC_MALLOC_ARENA_SIZE=65536

CONFIG_RING_BUFFER=y

#CONFIG_ASSERT=y
#CONFIG_ASSERT_LEVEL=1

## CONFIG I2C
CONFIG_I2C=y

## CONFIG SPI
#CONFIG_SPI=y
#CONFIG_NRFX_SPIM1=y
#CONFIG_SPI_1=y

## Config BME280
#CONFIG_SENSOR=y
#CONFIG_BME280=y

## Message box
CONFIG_NUM_MBOX_ASYNC_MSGS=10

## Counters 
CONFIG_COUNTER=y
CONFIG_COUNTER_TIMER4=y

## Power management
CONFIG_PM=y
CONFIG_TICKLESS_IDLE=y
CONFIG_SYS_POWER_MANAGEMENT=y
CONFIG_PM_POLICY_APP=y
#CONFIG_MP_NUM_CPUS=1

## CONFIG USB CDC
CONFIG_STDOUT_CONSOLE=y
CONFIG_GPIO=y
CONFIG_USB=y
CONFIG_USB_DEVICE_STACK=y
CONFIG_USB_DEVICE_PRODUCT="Zephyr CDC ACM sample"
#CONFIG_USB_DRIVER_LOG_LEVEL_ERR=y
#CONFIG_USB_CDC_ACM=y
#CONFIG_USB_DEVICE_LOG_LEVEL_ERR=y
CONFIG_SERIAL=y
CONFIG_LOG=y
CONFIG_UART_INTERRUPT_DRIVEN=y
CONFIG_UART_LINE_CTRL=y
```

## src/main.c
```c
#include <zephyr/types.h>
#include <stddef.h>
#include <stdio.h>
#include <errno.h>
#include <zephyr.h>
#include <sys/printk.h>
#include <sys/byteorder.h>
#include <sys/ring_buffer.h>

#include <drivers/gpio.h>
#include <drivers/uart.h>
#include <drivers/i2c.h>
#include <drivers/sensor.h>
#include <drivers/counter.h>

#include "fib.h"
#include "blinky.h"

/* Our own library of stuff! */
//#include "defines.h"
#include "usb_cdc.h"
//#include "ltr_303als.h"
//#include "bme280.h"
#include "uart.h"
#include "ll_uart.h"
//#include "powerman.h"
#include "led.h"

//#define PRINT usb_printf
#define PRINT printk

/* ********** */
/*   TIMER    */

#define TIMER DT_LABEL(DT_NODELABEL(timer4))
struct  counter_alarm_cfg alarm_cfg;

const struct device *counter_dev = NULL;

/* *************** */
/*   UART buffers  */

ll_driver_t uart_drv;
uart_dev_t uart0;

uint8_t uart0_in_buffer[1024];
uint8_t uart0_out_buffer[1024];

void top_return(act_t *act)
{
  return;
}

act_t top = { .step = top_return };

/* ************************************************************ */
/* hw_tick                                                      */
/* ************************************************************ */

struct k_mbox tick_mbox;

void hw_tick(const struct device *dev, uint8_t chan, uint32_t ticks, void *user_data) {

  /* Put a tick on the messagebox */
  struct k_mbox_msg send_msg;

  send_msg.info = 101;
  send_msg.size = 0;
  send_msg.tx_data = NULL;
  send_msg.tx_target_thread = K_ANY;

  /* third argument in async put is a semaphore
     that can be set to NULL if not "needed" _*/
  k_mbox_async_put(&tick_mbox, &send_msg, NULL);
}


K_THREAD_STACK_DEFINE(tick_thread_stack, 512);
struct k_thread tick_thread;

sv_int_t r;

void tick_thread_main(void * a, void* b, void *c) {
  (void)a;
  (void)b;
  (void)c;

  struct k_mbox_msg recv_msg;

  //sv_int_t r;
  initialize_int(&r);
  r.value = 0;
  now = 0;
  sv_int_t led;
  initialize_int(&led);
  led.value = 0;

  //PRINT("forking myfib\r\n");
  //fork_routine( (act_t *) enter_myfib(&top, PRIORITY_AT_ROOT, DEPTH_AT_ROOT, 4, &r) );

  PRINT("forking blinky\r\n");
  fork_routine( (act_t *) enter_main(&top, PRIORITY_AT_ROOT, DEPTH_AT_ROOT, &led) );



  PRINT("Waiting for ticks\r\n");
  int i = 0;
  while (1) {
    recv_msg.size = 0;
    recv_msg.rx_source_thread = K_ANY;

    //PRINT("step[%d]: r = %d\r\n", i, r.value);
    /* PRINT("now: %llu\r\n", now); */
    /* PRINT("next: %llu\r\n",next_event_time()); */
    /* PRINT("Events queued: %d\r\n", event_queue_len); */

    /* PRINT("step[%d]: led = %d\r\n", i, led.value); */
    /* PRINT("now: %llu\r\n", now); */
    /* PRINT("next: %llu\r\n",next_event_time()); */
    /* PRINT("Events queued: %d\r\n", event_queue_len); */


    /* get a data item, waiting as long as needed */
    k_mbox_get(&tick_mbox, &recv_msg, NULL, K_FOREVER);

    uint32_t count;
    counter_get_value(counter_dev, &count);


    PRINT("*** *** *** *** *** ***\r\n");
    PRINT("ctr: %u\r\n", count);
    PRINT("now: %llu\r\n", now);
    PRINT("next: %llu\r\n", next_event_time());

    now = next_event_time();
    tick();

    uint64_t next = next_event_time();
    PRINT("next after tick: %llu\r\n", next);

    if (next == ULLONG_MAX) {
      /* This just means that there are no events in the queue (or a remarkable coincidence) */
      /* What to do in this case ?*/
      /*  - Go to sleep and await being woken from outside source */

      PRINT("NOTHING IN THE QUEUE\r\n");
    }

    uint64_t wake_time = next_event_time(); /* Absolute time */

    //PRINT("sleep_time = %lld\r\n", sleep_time);

    alarm_cfg.flags = COUNTER_ALARM_CFG_ABSOLUTE | COUNTER_ALARM_CFG_EXPIRE_WHEN_LATE;
    alarm_cfg.ticks = wake_time;

    int r = counter_set_channel_alarm(counter_dev, 0, &alarm_cfg);
    if (!r) {
      //PRINT("hw_tick: Alarm set\r\n");
    } else {
      if (r == - ENOTSUP ) {
	PRINT("hw_tick: Error setting alarm (ENOTSUP)\r\n");
      } else if ( r == - EINVAL ) {
	PRINT("hw_tick: Error setting alarm (EINVAL)\r\n");
      } else if ( r == - ETIME ) {
	PRINT("hw_tick: Error setting alarm (ETIME)\r\n");
      } else {
	PRINT("hw_tick: Error setting alarm\r\n");
      }
    }

    i++;
  }
}

void start_tick_thread(void) {

  k_thread_create(&tick_thread, tick_thread_stack,
		  K_THREAD_STACK_SIZEOF(tick_thread_stack),
		  tick_thread_main,
		  NULL, NULL, NULL,
		  5, 0, K_NO_WAIT);
}

/* ************************************************************ */
/* MAIN                                                         */
/* ************************************************************ */

void main(void) {

  /* *************  */
  /* Start USB_CDC  */
  //  start_usb_cdc_thread();

  //PRINT("USB_CDC: started\r\n");
  PRINT("Sleeping 1 seconds\r\n");
  k_sleep(K_SECONDS(1)); // Wait enough for starting up a terminal.
  PRINT("WOKE UP\r\n");

  PRINT("Init LEDs\r\n");
  led_driver_t *led0 = led_init(0);
  if (!led0) {
    PRINT("ERROR INIT LEDs\r\n");
    return;
  }

  PRINT("Init Blinky\r\n");
  init_blinky();

  /* ********** */
  /* MESSAGEBOX */
  PRINT("Creating messagebox\n");
  k_mbox_init(&tick_mbox);


  /* ************************* */
  /* Hardware timer experiment */
  PRINT("Configuring hardware timer \r\n");
  counter_dev = device_get_binding(TIMER);
  if (!counter_dev) {
    PRINT("HWCounter: Device not found error\r\n");
  }

  PRINT("HWCounter: Running at %uMHz\r\n",
	  counter_get_frequency(counter_dev) / 1000000);

  alarm_cfg.flags = COUNTER_ALARM_CFG_ABSOLUTE | COUNTER_ALARM_CFG_EXPIRE_WHEN_LATE;
  alarm_cfg.ticks = 10; //counter_us_to_ticks(counter_dev, 0);
  alarm_cfg.callback = hw_tick;
  alarm_cfg.user_data = &alarm_cfg;


  if (!counter_set_channel_alarm(counter_dev, 0, &alarm_cfg)) {
    PRINT("HWCounter: Alarm set\r\n");
  } else {
    PRINT("HWCounter: Error setting alarm\r\n");
  }
  if (!counter_set_guard_period(counter_dev, UINT_MAX/2, COUNTER_GUARD_PERIOD_LATE_TO_SET)) {
    PRINT("HWCounter: Guard period set\r\n");
  } else {
    PRINT("HWCounter: Error setting guard period\r\n");
  }

  counter_start(counter_dev);


  /* configure uart */


  if (ll_uart_init(&uart_drv, UART0, &uart0, uart0_in_buffer, 1024, uart0_out_buffer, 1024)) {
    PRINT("LL_UART: OK!\r\n");
  } else {
    PRINT("LL_UART: Failed!\r\n");
  }

  PRINT("Starting Tick-Thread\r\n");
  start_tick_thread();

  int led0_state = 0;

  while(1) {
    led_set(led0,led0_state);
    led0_state = 1 - led0_state;
    k_sleep(K_SECONDS(4));
  }
}
```

## src/blinky.c
```c
#include <peng.h>
#include <peng-platform.h>

#include <led.h>

struct act_main {
   ACTIVATION_RECORD_FIELDS;
  sv_int_t *led;
  trigger_t trigger1;
};

typedef struct act_main act_main_t;

led_driver_t *led;

void init_blinky(void){
  led = led_init(1);
}


void step_main(act_t *bare_act)
{
  act_main_t *act = (act_main_t *) bare_act;
  switch (act->pc)
  {

  case 0: ;

  L0: ;
    led_set(led, act->led->value);
    later_int(act->led, now + 5000000L, 1);
    sensitize((sv_t *) act->led, &act->trigger1);
    act->pc = 1;
    return;

  case 1: ;
    desensitize(&act->trigger1);
    led_set(led, act->led->value);
    later_int(act->led, now + 5000000L, 0);
    sensitize((sv_t *) act->led, &act->trigger1);
    act->pc = 2;
    return;

  case 2: ;
    desensitize(&act->trigger1);
    goto L0;
  }
  leave((act_t *) act, sizeof(act_main_t));
}

act_main_t *enter_main( act_t *parent
                      , priority_t priority
                      , depth_t depth
                      , sv_int_t *led )
{
  act_main_t *act = (act_main_t *) enter( sizeof(act_main_t)
                                        , step_main
                                        , parent
                                        , priority
                                        , depth );
  act->led = led;
  act->trigger1.act = (act_t *) act;
  return act;
}
```

## src/blinky.h
```c
#ifndef BLINKY_H_
#define BLINKY_H_

struct act_main {
   ACTIVATION_RECORD_FIELDS;
  sv_int_t *led;
  trigger_t trigger1;
};

typedef struct act_main act_main_t;

extern act_main_t *enter_main( act_t *parent
			       , priority_t priority
			       , depth_t depth
			       , sv_int_t *led );
#endif
```

## src/fib.h
```c
#ifndef FIB_H_
#define FIB_H_

#include "peng-platform.h"
#include "peng.h"

typedef struct {
    /* Generic procedure fields */
    ACTIVATION_RECORD_FIELDS;
    /* Procedure specific fields */
    sv_int_t n; // Procedure argument
    sv_int_t *r; // Procedure argument
    sv_int_t r1; // Declared at (22, 5) in file Fib.hs
    sv_int_t r2; // Declared at (23, 5) in file Fib.hs
} act_myfib_t;


extern act_myfib_t *enter_myfib(act_t *caller, uint32_t priority, uint8_t depth, int n, sv_int_t *r);


#endif
```

## src/fib_3_17.c
```c
#include "peng-platform.h"
#include "peng.h"
#include <stdio.h>

typedef struct {
    /* Generic procedure fields */
    ACTIVATION_RECORD_FIELDS;
    /* Procedure specific fields */
    sv_int_t *r; // Procedure argument
    trigger_t trig1;
} act_mywait_t;

act_mywait_t *enter_mywait(act_t *caller, uint32_t priority, uint8_t depth, sv_int_t *r);
void step_mywait(act_t *gen_act);

act_mywait_t *enter_mywait(act_t *caller, uint32_t priority, uint8_t depth, sv_int_t *r) {
    act_mywait_t *act = (act_mywait_t *) enter(sizeof(act_mywait_t), step_mywait, caller, priority, depth);
    act->r = r;
    act->trig1.act = (act_t *) act;
    return act;
};

void step_mywait(act_t *gen_act) {
    act_mywait_t *act = (act_mywait_t *) gen_act;
    switch(act->pc) {
        case 0:
            sensitize((sv_t *) act->r, &act->trig1);
            act->pc = 1;
            return;

        case 1:

        leave((act_t *) act, sizeof(act_mywait_t));
    }
}

typedef struct {
    /* Generic procedure fields */
    ACTIVATION_RECORD_FIELDS;
    /* Procedure specific fields */
    sv_int_t *r1; // Procedure argument
    sv_int_t *r2; // Procedure argument
    sv_int_t *r; // Procedure argument
    sv_int_t v1; // Declared at (16, 5) in file Fib.hs
    sv_int_t v2; // Declared at (17, 5) in file Fib.hs
} act_mysum_t;

act_mysum_t *enter_mysum(act_t *caller, uint32_t priority, uint8_t depth, sv_int_t *r1, sv_int_t *r2, sv_int_t *r);
void step_mysum(act_t *gen_act);

act_mysum_t *enter_mysum(act_t *caller, uint32_t priority, uint8_t depth, sv_int_t *r1, sv_int_t *r2, sv_int_t *r) {
    act_mysum_t *act = (act_mysum_t *) enter(sizeof(act_mysum_t), step_mysum, caller, priority, depth);
    act->r1 = r1;
    act->r2 = r2;
    act->r = r;
    return act;
};

void step_mysum(act_t *gen_act) {
    act_mysum_t *act = (act_mysum_t *) gen_act;
    switch(act->pc) {
        case 0:
            {
            uint8_t new_depth = act->depth - 1;
            uint32_t pinc = 1 << new_depth;
            uint32_t new_priority = act->priority;
            fork_routine((act_t *) enter_mywait( (act_t *) act
                                               , new_priority
                                               , new_depth
                                               , act->r1));
            new_priority += pinc;
            fork_routine((act_t *) enter_mywait( (act_t *) act
                                               , new_priority
                                               , new_depth
                                               , act->r2));
            }
            act->pc = 1;
            return;

        case 1:
            assign_int(&act->v1, act->priority, act->r1->value);
            assign_int(&act->v2, act->priority, act->r2->value);
            later_int(act->r, now + 1, (act->v1.value) + (act->v2.value));

        leave((act_t *) act, sizeof(act_mysum_t));
    }
}

typedef struct {
    /* Generic procedure fields */
    ACTIVATION_RECORD_FIELDS;
    /* Procedure specific fields */
    sv_int_t n; // Procedure argument
    sv_int_t *r; // Procedure argument
    sv_int_t r1; // Declared at (22, 5) in file Fib.hs
    sv_int_t r2; // Declared at (23, 5) in file Fib.hs
} act_myfib_t;

act_myfib_t *enter_myfib(act_t *caller, uint32_t priority, uint8_t depth, int n, sv_int_t *r);
void step_myfib(act_t *gen_act);

act_myfib_t *enter_myfib(act_t *caller, uint32_t priority, uint8_t depth, int n, sv_int_t *r) {
    act_myfib_t *act = (act_myfib_t *) enter(sizeof(act_myfib_t), step_myfib, caller, priority, depth);
    initialize_int(&act->n);
    assign_int(&act->n, act->priority, n);
    act->r = r;
    return act;
};

void step_myfib(act_t *gen_act) {
    act_myfib_t *act = (act_myfib_t *) gen_act;
    switch(act->pc) {
        case 0:
            initialize_int(&act->r1);
            assign_int(&act->r1, act->priority, 0);
            initialize_int(&act->r2);
            assign_int(&act->r2, act->priority, 0);
            if (!((act->n.value) < (2))) goto L0;
            later_int(act->r, now + 1, 1);
            goto L1;

        L0:
            {
            uint8_t new_depth = act->depth - 1;
            uint32_t pinc = 1 << new_depth;
            uint32_t new_priority = act->priority;
            fork_routine((act_t *) enter_myfib( (act_t *) act
                                              , new_priority
                                              , new_depth
                                              , (act->n.value) - (1)
                                              , &act->r1));
            new_priority += pinc;
            fork_routine((act_t *) enter_myfib( (act_t *) act
                                              , new_priority
                                              , new_depth
                                              , (act->n.value) - (2)
                                              , &act->r2));
            new_priority += pinc;
            fork_routine((act_t *) enter_mysum( (act_t *) act
                                              , new_priority
                                              , new_depth
                                              , &act->r1
                                              , &act->r2
                                              , act->r));
            }
            act->pc = 1;
            return;

        case 1:

        L1:

        leave((act_t *) act, sizeof(act_myfib_t));
    }
}
```
