## CMakeLists.txt
```
# SPDX-License-Identifier: Apache-2.0

cmake_minimum_required(VERSION 3.20.0)
find_package(Zephyr HINTS $ENV{ZEPHYR_BASE})
project(scanner)

FILE(GLOB app_sources src/*.c)

# FILE(GLOB extra_sources
#   ../common/src/*.c
#   ../common/src/abstraction/zephyr/*.c
#   ./peng/runtime/src/*.c
#   )

  # ../common/src
  # ../common/src/abstraction/zephyr
  # ./peng/runtime/include
  # ./peng-platform/nrf52/include


target_sources(app PRIVATE ${app_sources} ${extra_sources})
target_include_directories(app PRIVATE
  ${ZEPHYR_BASE}/kernel/include
  ${ZEPHYR_BASE}/arch/${ARCH}/include)
```

## prj.conf
```kconfig
CONFIG_BT=y
CONFIG_BT_BROADCASTER=y
CONFIG_BT_OBSERVER=y
#CONFIG_BT_DEBUG_LOG=y
#CONFIG_BT_DEBUG_HCI_CORE=y
#CONFIG_ASSERT=y
# CONFIG_BT_GATT_DYNAMIC_DB=y
# # CONFIG_BT_DEBUG_LOG=n
# CONFIG_BT_SMP=y
# CONFIG_BT_PERIPHERAL=y
# CONFIG_BT_DIS=y
# CONFIG_BT_DIS_PNP=y
# CONFIG_BT_DEVICE_NAME="Client"
# CONFIG_BT_CENTRAL=y
# CONFIG_BT_SMP=y

#CONFIG_BT_GATT_CLIENT=y
#CONFIG_BT_GATT_SERVICE_CHANGED=y
#CONFIG_BT_GATT_CACHING=y

# without this it does not link in the k_malloc code, it will just
# cryptically throw undefined reference k_malloc in your face. Including
# kernel.h where it is defined does nothing. With this thing, however, it
# is not even required to include kernel.h.
#CONFIG_HEAP_MEM_POOL_SIZE=32768
# This flag is explained here: https://docs.zephyrproject.org/1.9.0/reference/kconfig/CONFIG_SYS_CLOCK_TICKS_PER_SEC.html#cmdoption-arg-config-sys-clock-ticks-per-sec
# CONFIG_SYS_CLOCK_TICKS_PER_SEC=1000
#CONFIG_MINIMAL_LIBC_MALLOC_ARENA_SIZE=65536

CONFIG_RING_BUFFER=y

#CONFIG_ASSERT=y
#CONFIG_ASSERT_LEVEL=1

## CONFIG I2C
#CONFIG_I2C=y

## CONFIG SPI
#CONFIG_SPI=y
#CONFIG_NRFX_SPIM1=y
#CONFIG_SPI_1=y

## Config BME280
#CONFIG_SENSOR=y
#CONFIG_BME280=y

## Message box
#CONFIG_NUM_MBOX_ASYNC_MSGS=10

## Counters
#CONFIG_COUNTER_RTC_STM32=y
#CONFIG_COUNTER=y
#CONFIG_COUNTER_TIMER4=y
#CONFIG_HAS_STM32CUBE=y
#CONFIG_USE_STM32_HAL_TIM=y
## Power management
#CONFIG_PM=y
#CONFIG_SYS_POWER_MANAGEMENT=y
#CONFIG_PM_POLICY_APP=y
#CONFIG_MP_NUM_CPUS=1

## CONFIG USB CDC
# CONFIG_STDOUT_CONSOLE=y
# CONFIG_GPIO=y
# CONFIG_USB=y
# CONFIG_USB_DEVICE_STACK=y
# CONFIG_USB_DEVICE_PRODUCT="Zephyr CDC ACM sample"
#CONFIG_USB_DRIVER_LOG_LEVEL_ERR=y
#CONFIG_USB_CDC_ACM=y
#CONFIG_USB_DEVICE_LOG_LEVEL_ERR=y
# CONFIG_SERIAL=y
# CONFIG_LOG=y
# CONFIG_UART_INTERRUPT_DRIVEN=y
# CONFIG_UART_LINE_CTRL=y
```

## stm32f4_discovery.overlay
```dts
/ {
     aliases {
          ssm-button0 = &user_button;
	  ssm-timer   = &rtc; /* not working */

	  ssm-led0    = &green_led_4;
	  ssm-led1    = &orange_led_3;
	  
     };
};

&timers3 {
	 status = "okay";
};
```

## src/main.c
```c
#include <zephyr/types.h>
#include <stddef.h>
#include <sys/printk.h>
#include <sys/util.h>

#include <bluetooth/bluetooth.h>
#include <bluetooth/hci.h>

static uint8_t mfg_data[] = { 0xff, 0xff, 0x00 };


#define MAX_MESSAGES 100
#define MSG_ALIGNMENT 4

typedef struct {
  int8_t rssi;
  uint8_t adv_type;
  char str[256];
}scan_msg_t;


K_MSGQ_DEFINE(mq, sizeof(scan_msg_t), MAX_MESSAGES, MSG_ALIGNMENT);

int send_message(scan_msg_t msg) {

  return k_msgq_put(&mq,(void*)&msg, K_NO_WAIT);
}


int poll_message(scan_msg_t *msg) {

  int r = k_msgq_get(&mq, (void*)msg, K_NO_WAIT);

  if (r == -ENOMSG || r == -EAGAIN) {
    return 0;
  }
  return 1;
}

static const struct bt_data ad[] =
  {
   BT_DATA(BT_DATA_MANUFACTURER_DATA, mfg_data, 3),
  };

static void scan_cb(const bt_addr_le_t *addr, int8_t rssi, uint8_t adv_type,
		    struct net_buf_simple *buf){
  scan_msg_t msg;

  msg.rssi = rssi;
  msg.adv_type = adv_type;
  bt_addr_le_to_str (addr,msg.str,256);

  send_message(msg);
  
 
}

void main(void){
  struct bt_le_scan_param scan_param = {
					.type       = BT_HCI_LE_SCAN_PASSIVE,
					.options    = BT_LE_SCAN_OPT_NONE,
					.interval   = 0x0010,
					.window     = 0x0010,
  };
  int err;

  printk("Starting Scanner/Advertiser Demo\n");

  /* Initialize the Bluetooth Subsystem */
  err = bt_enable(NULL);
  if (err) {
    printk("Bluetooth init failed (err %d)\n", err);
    return;
  }

  /* printk("Bluetooth initialized\n"); */

  err = bt_le_scan_start(&scan_param, scan_cb);
  if (err) {
    printk("Starting scanning failed (err %d)\n", err);
    return;
  }

  do {
    k_sleep(K_MSEC(400));

    
    printk("looopie\r\n");

    
    scan_msg_t msg;
    
    while (poll_message(&msg) == 1) {
      printk("RSSI: %d\r\n", msg.rssi);
      printk("type: %u\r\n", msg.adv_type);
      printk("addr: %s\r\n", msg.str);
    }
    
       
    /* Start advertising */
    err = bt_le_adv_start(BT_LE_ADV_NCONN, ad, ARRAY_SIZE(ad),
    			  NULL, 0);
    if (err) {
      printk("Advertising failed to start (err %d)\n", err);
      return;
    }

    k_sleep(K_MSEC(400));

    err = bt_le_adv_stop();
    if (err) {
      printk("Advertising failed to stop (err %d)\n", err);
      return;
    }
  } while (1);
}
```
