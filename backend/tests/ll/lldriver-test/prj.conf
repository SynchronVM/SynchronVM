## CMakeLists.txt
```
# SPDX-License-Identifier: Apache-2.0

cmake_minimum_required(VERSION 3.13.1)
find_package(Zephyr HINTS $ENV{ZEPHYR_BASE})
project(lldriver-test)

set(LLBC   ../../../src/ll)
set(LLBC_Z ../../../src/ll/os/zephyr)

set(LLBH_Z ../../../include/ll/os/zephyr)

set(SENSE_VM ../../../src)       # currently unused
set(SENSE_VM_H ../../../include) 

FILE(GLOB app_sources src/*.c)
FILE(GLOB extra_sources
  ${LLBC}/ll_driver.c
  ${LLBC}/ll_led.c
  ${LLBC}/ll_uart.c
  ${LLBC_Z}/led.c
  ${LLBC_Z}/uart.c)


target_sources(app PRIVATE ${app_sources} ${extra_sources})
target_include_directories(app PRIVATE
  ${LLBH_Z}
  ${SENSE_VM_H}
  ${ZEPHYR_BASE}/kernel/include
  ${ZEPHYR_BASE}/arch/${ARCH}/include)


zephyr_library_include_directories(${ZEPHYR_BASE}/samples/bluetooth)
```

## prj.conf
```kconfig
CONFIG_RING_BUFFER=y
#CONFIG_ASSERT=y
#CONFIG_ASSERT_LEVEL=1

## CONFIG I2C
#CONFIG_I2C=y

## CONFIG SPI
#CONFIG_SPI=y
##CONFIG_NRFX_SPIM1=y
##CONFIG_SPI_1=y

## Config BME280
#CONFIG_SENSOR=y
#CONFIG_BME280=y

## Counters 
# CONFIG_COUNTER=y
# CONFIG_COUNTER_TIMER4=y

## Power management
#CONFIG_PM=y
#CONFIG_SYS_POWER_MANAGEMENT=y
#CONFIG_PM_POLICY_APP=y
# CONFIG_MP_NUM_CPUS=1
#CONFIG_CLOCK_CONTROL=y
#CONFIG_CLOCK_CONTROL_NRF=y

## Thread statistics
CONFIG_THREAD_NAME=y
CONFIG_THREAD_RUNTIME_STATS=y
CONFIG_THREAD_MONITOR=y

## CONFIG USB CDC
CONFIG_STDOUT_CONSOLE=y
CONFIG_GPIO=y
CONFIG_USB=y
CONFIG_USB_DEVICE_STACK=y
CONFIG_USB_DEVICE_PRODUCT="Zephyr CDC ACM sample"
CONFIG_USB_DRIVER_LOG_LEVEL_ERR=y
CONFIG_USB_CDC_ACM=y
CONFIG_USB_DEVICE_LOG_LEVEL_ERR=y
CONFIG_SERIAL=y
CONFIG_UART_INTERRUPT_DRIVEN=y
# CONFIG_UART_LINE_CTRL=y
```

## src/main.c
```c
#include <zephyr/types.h>
#include <stddef.h>
#include <stdio.h>
#include <errno.h>
#include <zephyr.h>
#include <sys/printk.h>

#include <sys/ring_buffer.h>

#include <drivers/gpio.h>
#include <drivers/uart.h>
#include <drivers/i2c.h>
#include <drivers/sensor.h>
#include <drivers/counter.h>

#include <kernel.h>

/* Our own library of stuff! */
#include <ll/ll_driver.h>
#include <ll/ll_uart.h>
#include <ll/ll_led.h>
#include <hal/zephyr/svm_zephyr.h>

//#include <ll/powerman.h>
//#include <ll/timerman.h>

//#define PRINT usb_printf
#define PRINT printk

/* *************** */
/*   UART buffers  */

uint8_t uart0_in_buffer[1024];
uint8_t uart0_out_buffer[1024];

/* *************************/
/* Interrupt message queue */
#define MAX_MESSAGES 100
#define MSG_ALIGNMENT 4

K_MSGQ_DEFINE(message_queue, sizeof(svm_msg_t),MAX_MESSAGES, MSG_ALIGNMENT);

int send_message(zephyr_interop_t* this, svm_msg_t msg) {

  return k_msgq_put(this->msgq,(void*)&msg, K_NO_WAIT);
}

zephyr_interop_t zephyr_interop;

/* ****************** */
/* Thread info dumper */

static int t_counter = 0; 

void t_info_dump(const struct k_thread *cthread, void *user_data) { 
  struct k_thread *thread = (struct k_thread *)cthread;
  const char *tname;

  tname = k_thread_name_get(thread);

  PRINT("%s%p %-10s",
	(thread == k_current_get()) ? "*" : " ",
	thread,
	tname ? tname : "NA");
  PRINT("\toptions: 0x%x, priority: %d timeout: %lld",
	thread->base.user_options,
	thread->base.prio,
	thread->base.timeout.dticks);
  PRINT("\tstate: %s\r\n", k_thread_state_str(thread));

  t_counter++;

}

void main(void) {

  PRINT("Pause 1 seconds\r\n");
  //k_sleep(K_SECONDS(5));

  /* ***************** */
  /* Register powerman */ 
  //powerman_init();

  //PRINT("POWERMAN: started\r\n");
  
  //k_sleep(K_SECONDS(5));

  k_thread_foreach(t_info_dump, NULL);

  PRINT("t_info_dump called %d times\r\n", t_counter);

  /**********************/
  /* Initialize interop */

  zephyr_interop.msgq = &message_queue;
  zephyr_interop.send_message = send_message;

  
  /* ******************* */
  /* Configure some LEDs */

  ll_driver_t led0;
  ll_driver_t led1;

  if (ll_led_init(&led0, 0, 0)) {
    PRINT("LL_LED: OK init led0\r\n");
  } else {
    PRINT("LL_LED: FAILED init led0\r\n");
  }

  if (ll_led_init(&led1, 1, 1)) {
    PRINT("LL_LED: OK init led1\r\n");
  } else {
    PRINT("LL_LED: FAILED init led1\r\n");
  }
  
  /* configure uart */

  ll_driver_t uart_drv;

  PRINT("STARTING UARTS\r\n");
  if (ll_uart_init(&uart_drv, UART_IF1, uart0_in_buffer, 1024, uart0_out_buffer, 1024,(void*)&zephyr_interop)) {
    PRINT("LL_UART: OK!\r\n");
  } else {
    PRINT("LL_UART: Failed!\r\n");
  }
  PRINT("UARTS STARTED\r\n");
  
  const char *hello = "hello world\r\n"; 
 
  while (1) {

    ll_write(&uart_drv, (uint8_t*)hello, strlen(hello));
    uint8_t led0_state;
    uint8_t led1_state;

    ll_read(&led0, &led0_state, 1);
    ll_read(&led1, &led1_state, 1);

    led0_state = 1 - led0_state;
    led1_state = 1 - led1_state;
    
    ll_write(&led0, &led0_state, 1);
    ll_write(&led1, &led1_state, 1);
    
    k_sleep(K_SECONDS(1));
  }

}
```
