## backend/tests/ll/boards/arm/nrf_module_v1/Kconfig
```kconfig
# Kconfig - NRF_MODULE_V1 board configuration
#
# Copyright (c) 2021 Joel Svensson
#
# SPDX-License-Identifier: Apache-2.0

config BOARD_ENABLE_DCDC
        bool "Enable DCDC mode"
        select SOC_DCDC_NRF52X
        default y
	depends on BOARD_NRF_MODULE_V1
```

## backend/tests/ll/boards/arm/nrf_module_v1/nrf_module_v1_defconfig
```kconfig
# SPDX-License-Identifier: Apache-2.0

CONFIG_SOC_SERIES_NRF52X=y
CONFIG_SOC_NRF52840_QIAA=y
CONFIG_BOARD_NRF_MODULE_V1=y  

# Enable MPU
CONFIG_ARM_MPU=y

# Enable RTT
#CONFIG_HAS_SEGGER_RTT=y

# enable GPIO
CONFIG_GPIO=y

# enable uart driver 
CONFIG_SERIAL=y

# enable console
CONFIG_CONSOLE=y
CONFIG_UART_CONSOLE=y

# Settings needed NRF_MODULE_V1 (BMD340 module)
CONFIG_CLOCK_CONTROL_NRF_K32SRC_XTAL=n
CONFIG_CLOCK_CONTROL_NRF_K32SRC_RC=n
CONFIG_CLOCK_CONTROL_NRF_K32SRC_SYNTH=y
CONFIG_GPIO_AS_PINRESET=n
```

## experiments/zephyr/boards/arm/bg95_iot_board/Kconfig.defconfig
```kconfig
# STM32F4DISCOVERY board configuration

# Copyright (c) 2016 Linaro Limited.
# SPDX-License-Identifier: Apache-2.0

if BOARD_BG95_IOT_BOARD

config BOARD
	default "bg95_iot_board"

endif # BOARD_BG95_IOT_BOARD
```

## experiments/zephyr/server/build/Kconfig/Kconfig.soc.arch
```kconfig
osource "/home/joels/Work/zephyrproject/zephyr/soc/$(ARCH)/Kconfig"
osource "/home/joels/Work/zephyrproject/zephyr/soc/$(ARCH)/*/Kconfig"
```

## experiments/zephyr/zephyr-code-from-ssm-edsl/boards/arm/nrf_module_v1/Kconfig.board
```kconfig
# Kconfig - NRF_MODULE_V1  board configuration
#
# Copyright (c) 2021 Joel Svensson
#
# SPDX-License-Identifier: Apache-2.0

config  BOARD_NRF_MODULE_V1
	bool "NRF MODULE V1"
	depends on SOC_NRF52840_QIAA
```

## experiments/zephyr/zephyr-code-from-ssm-edsl/boards/arm/nrf_module_v1/Kconfig.defconfig
```kconfig
# Kconfig - NRF_MODULE_V1 board configuration
#
# Copyright (c) 2016 Nordic Semiconductor ASA
#
# SPDX-License-Identifier: Apache-2.0

if BOARD_NRF_MODULE_V1

config BOARD
	default "nrf_module_v1"

if I2C

config I2C_0
       bool
       default y

endif # I2C

if SPI

config SPI_1
       bool
       default y

#config SPI_2
#	default y

endif # SPI

if USB

config USB_NRFX
	default y

config USB_DEVICE_STACK
	default y

endif # USB

if IEEE802154

config IEEE802154_NRF5
	default y

endif # IEEE802154

config BT_CTLR
	default BT

endif # BOARD_NRF_MODULE_V1
```

## experiments/zephyr/zephyr-code-from-ssm-edsl/boards/arm/octopi_iot_board/Kconfig.defconfig
```kconfig
# STM32F4DISCOVERY board configuration

# Copyright (c) 2016 Linaro Limited.
# SPDX-License-Identifier: Apache-2.0

if BOARD_OCTOPI_IOT_BOARD

config BOARD
	default "octopi_iot_board"

endif # BOARD_OCTOPI_IOT_BOARD
```

## zephyr-examples/boards/arm/bg95_iot_board/Kconfig.board
```kconfig
# STM32F4DISCOVERY board configuration

# Copyright (c) 2016 Linaro Limited.
# SPDX-License-Identifier: Apache-2.0

config BOARD_BG95_IOT_BOARD
	bool "BG95 IOT BOARD"
	depends on SOC_STM32F405XG
```
